## zmk-input-processor-min-speed/Kconfig
```kconfig
# Copyright (c) 2024 The ZMK Contributors
# SPDX-License-Identifier: MIT

config ZMK_INPUT_PROCESSOR_MIN_SPEED
    bool "Enable minimum speed input processor"
    default y
    help
      Enable the minimum speed input processor which ensures mouse
      movements have a minimum speed threshold.
```

## zmk-input-processor-min-speed/dts/bindings/zmk,input-processor-min-speed.yaml
```yaml
# Copyright (c) 2024 The ZMK Contributors
# SPDX-License-Identifier: MIT

description: |
  Input processor that ensures a minimum speed for mouse movements.
  When the input value is non-zero but below the minimum threshold,
  it is boosted to the minimum value while preserving the direction (sign).

compatible: "zmk,input-processor-min-speed"

include: input-processor-base.yaml

properties:
  type:
    type: int
    required: true
    description: |
      The event type/code for the input event to listen for and potentially modify.
      Use INPUT_EV_REL (0x02) for relative movement events like mouse movement.

  codes:
    type: array
    required: true
    description: |
      Array of input codes to apply minimum speed to. Typically includes:
      - INPUT_REL_X (0x00) for horizontal movement
      - INPUT_REL_Y (0x01) for vertical movement

  min-value:
    type: int
    required: true
    description: |
      The minimum absolute value for the input. If the absolute value of the
      input is greater than 0 but less than this value, it will be boosted to
      this minimum value. The sign (direction) is always preserved.
```
